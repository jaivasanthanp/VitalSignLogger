/* ssd1306.c — SSD1306 128×64 OLED driver for VitalSignLogger
 *
 * I2C wiring (shared with MAX30102 + MPU6050 on I2C1):
 *   SDA → PB9   SCL → PB8   VCC → 3.3 V   GND → GND
 *
 * All draw calls write to a 1024-byte framebuffer in SRAM.
 * Call SSD1306_Flush() (while holding i2cMutexHandle) to push to display.
 */

#include "ssd1306.h"
#include <string.h>

/* ---------------------------------------------------------------
 * Standard 5×8 ASCII font, columns LSB = top pixel.
 * Covers printable ASCII 0x20 (space) … 0x7E (~).
 * --------------------------------------------------------------- */
static const uint8_t font5x8[95][5] = {
    {0x00,0x00,0x00,0x00,0x00}, /* 0x20   */
    {0x00,0x00,0x5F,0x00,0x00}, /* 0x21 ! */
    {0x00,0x07,0x00,0x07,0x00}, /* 0x22 " */
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    {0x10,0x08,0x08,0x10,0x08}, /* 0x7E ~ */
};

/* ---------------------------------------------------------------
 * Framebuffer: fb[page][col], page = row of 8 px, col = pixel column
 * --------------------------------------------------------------- */
static uint8_t fb[SSD1306_PAGES][SSD1306_WIDTH];
static I2C_HandleTypeDef *_hi2c;

/* Send one command byte */
static void ssd_cmd(uint8_t c)
{
    HAL_I2C_Mem_Write(_hi2c, SSD1306_ADDR, 0x00, 1, &c, 1, 10);
}

/* ---------------------------------------------------------------
 * SSD1306_Init
 * Standard 128×64 init sequence. Caller must hold i2cMutexHandle.
 * --------------------------------------------------------------- */
void SSD1306_Init(I2C_HandleTypeDef *hi2c)
{
    _hi2c = hi2c;

    ssd_cmd(0xAE);        /* display off */
    ssd_cmd(0xD5);
    ssd_cmd(0x80);        /* clock divide ratio / oscillator */
    ssd_cmd(0xA8);
    ssd_cmd(0x3F);        /* multiplex ratio 63 (64 rows) */
    ssd_cmd(0xD3);
    ssd_cmd(0x00);        /* display offset = 0 */
    ssd_cmd(0x40);        /* start line = 0 */
    ssd_cmd(0x8D);
    ssd_cmd(0x14);        /* charge pump enable */
    ssd_cmd(0x20);
    ssd_cmd(0x00);        /* horizontal addressing mode */
    ssd_cmd(0xA1);        /* segment remap: col 127 → SEG0 */
    ssd_cmd(0xC8);        /* COM scan remapped (top→bottom) */
    ssd_cmd(0xDA);
    ssd_cmd(0x12);        /* COM pins hardware config */
    ssd_cmd(0x81);
    ssd_cmd(0xCF);        /* contrast */
    ssd_cmd(0xD9);
    ssd_cmd(0xF1);        /* pre-charge period */
    ssd_cmd(0xDB);
    ssd_cmd(0x40);        /* Vcomh deselect level */
    ssd_cmd(0xA4);        /* display from RAM */
    ssd_cmd(0xA6);        /* normal display (not inverted) */
    ssd_cmd(0xAF);        /* display on */
}

/* ---------------------------------------------------------------
 * SSD1306_Clear — zero framebuffer (no I2C)
 * --------------------------------------------------------------- */
void SSD1306_Clear(void)
{
    memset(fb, 0, sizeof(fb));
}

/* ---------------------------------------------------------------
 * SSD1306_DrawString
 * Writes characters to the framebuffer at (col, page).
 * Each char is 6 px wide (5 glyph + 1 px spacing). No I2C.
 * --------------------------------------------------------------- */
void SSD1306_DrawString(uint8_t col, uint8_t page, const char *str)
{
    if (page >= SSD1306_PAGES) return;
    while (*str && col < SSD1306_WIDTH) {
        uint8_t c = (uint8_t)*str++;
        if (c < 0x20 || c > 0x7E) c = 0x20;
        const uint8_t *g = font5x8[c - 0x20];
        for (int i = 0; i < 5 && (col + i) < SSD1306_WIDTH; i++) {
            fb[page][col + i] = g[i];
        }
        if (col + 5 < SSD1306_WIDTH) fb[page][col + 5] = 0x00;
        col += 6;
    }
}

/* ---------------------------------------------------------------
 * SSD1306_Flush
 * Sends the full 1024-byte framebuffer over I2C.
 * At the configured 100 kHz this takes ~103 ms.
 * Caller must hold i2cMutexHandle for the duration.
 * --------------------------------------------------------------- */
void SSD1306_Flush(void)
{
    ssd_cmd(0x21); ssd_cmd(0x00); ssd_cmd(0x7F); /* column address 0-127 */
    ssd_cmd(0x22); ssd_cmd(0x00); ssd_cmd(0x07); /* page address 0-7    */
    HAL_I2C_Mem_Write(_hi2c, SSD1306_ADDR, 0x40, 1,
                      (uint8_t *)fb, sizeof(fb), 200);
}
